## CMakeLists.txt
```
# SPDX-License-Identifier: Apache-2.0

cmake_minimum_required(VERSION 3.20.0)

find_package(Zephyr REQUIRED HINTS $ENV{ZEPHYR_BASE})
project(nanopb_demo)

list(APPEND CMAKE_MODULE_PATH ${ZEPHYR_BASE}/modules/nanopb)
include(nanopb)

zephyr_nanopb_sources(app src/demo.proto)

# nanopb_generate_cpp(proto_sources proto_headers RELPATH .
#     src/protocol.proto
# )

target_sources(app PRIVATE src/main.c)
```

## west.yml
```
# Copyright (c) 2021 Nordic Semiconductor ASA
# SPDX-License-Identifier: Apache-2.0

manifest:
  group-filter: [+optional]
  self:
    path: nanopb-demo
    west-commands: scripts/west-commands.yml

  remotes:
    - name: zephyrproject-rtos
      url-base: https://github.com/zephyrproject-rtos

  projects:
    - name: zephyr
      remote: zephyrproject-rtos
      revision: main
      import:
        path-allowlist:
        - modules/hal/espressif
        - bootloader/mcuboot
        - modules/lib/nanopb
        - modules/crypto/tinycrypt
        - modules/crypto/mbedtls
```

## prj.conf
```kconfig
CONFIG_NANOPB=y
CONFIG_LOG=y
CONFIG_LOG_MODE_DEFERRED=y
CONFIG_LOG_PRINTK=y
```

## src/main.c
```c
#include <zephyr/kernel.h>
#include <zephyr/logging/log.h>
#include <pb_encode.h>
#include "src/demo.pb.h"

LOG_MODULE_REGISTER(main, LOG_LEVEL_INF);

int main() {
  uint8_t buffer[Hello_size];
  
  while(1) {
    Hello hello_msg = Hello_init_zero;
    hello_msg.time = k_uptime_get();
    hello_msg.val = 42;

    pb_ostream_t stream = pb_ostream_from_buffer(buffer, Hello_size);
    bool status = pb_encode(&stream, Hello_fields, &hello_msg);
    size_t len = stream.bytes_written;

    LOG_INF("wrote %d bytes to output buffer, status %d", len, status);
    k_msleep(1000);
  }
}
```
